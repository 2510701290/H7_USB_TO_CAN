## boards/H7_Work/H7_Work_defconfig
```kconfig
# Copyright (c) 2025 roboparty <2321901849@qq.com>
# SPDX-License-Identifier: GPL-3.0-only

# Enable MPU
CONFIG_ARM_MPU=y

# Enable HW stack protection
CONFIG_HW_STACK_PROTECTION=y

# Enable GPIO
CONFIG_GPIO=y
```

## boards/H7_Work/board.yml
```yaml
board:
  name: H7_Work
  full_name: H7_Work
  vendor: RoboBraver
  socs:
    - name: stm32h723xx
      variants:
        - name: 'H7_Work'
```
